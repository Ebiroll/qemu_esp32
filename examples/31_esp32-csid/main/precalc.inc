unsigned int TriSaw_8580[4096] = {
0,0,0,0,0,0,0,0,0,0,0,0,0,0,0,84,0,0,0,0,0,0,0,24,0,0,0,0,0,0,144,180,0,0,0,0,0,0,0,0,0,0,0,0,0,0,0,84,0,0,0,0,0,0,0,24,0,0,0,0,288,288,336,372,0,0,0,0,0,0,0,0,0,0,0,0,0,0,0,84,0,0,0,0,0,0,0,24,0,0,0,0,0,0,144,180,0,0,0,0,
0,0,0,24,0,0,0,0,0,0,0,84,0,0,0,0,0,0,0,24,192,576,576,576,672,672,720,756,0,0,0,0,0,0,0,0,0,0,0,0,0,0,0,84,0,0,0,0,0,0,0,24,0,0,0,0,0,0,144,180,0,0,0,0,0,0,0,24,0,0,0,0,0,0,0,84,0,0,0,0,0,0,0,24,0,0,0,192,288,288,336,372,0,0,0,0,0,0,0,0,
0,0,0,0,0,0,0,84,0,0,0,0,0,0,0,24,0,0,0,0,0,96,144,180,0,0,0,0,0,0,0,24,0,0,0,0,0,0,0,84,0,1152,1152,1152,1152,1152,1152,1176,1344,1344,1344,1344,1440,1440,1488,1524,0,0,0,0,0,0,0,0,0,0,0,0,0,0,0,84,0,0,0,0,0,0,0,24,0,0,0,0,0,0,144,180,0,0,0,0,0,0,0,24,0,0,0,0,
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46080,46080,46080,46080,46080,46080,46080,46104,46080,46080,46080,46080,46080,46080,46080,46164,46080,46080,46080,46080,46080,46080,46080,46104,46080,46080,46272,46272,46368,46368,46416,46452,47616,47616,47616,47616,47616,47616,47616,47616,47616,47616,47616,47616,47616,47616,47616,47700,47616,47616,47616,47616,47616,47616,47616,47640,47616,47616,47616,47616,47616,47712,47760,47796,48384,48384,48384,48384,48384,48384,48384,48408,48384,48384,48384,48384,48384,48384,48432,48468,48768,48768,48768,48768,48768,48768,48768,48792,48960,48960,48960,48960,49056,49056,49104,49140,};

unsigned int PulseSaw_8580[4096] = {
0,0,0,0,0,0,0,36,0,0,0,12,0,0,48,84,0,0,0,12,0,0,0,84,0,0,0,36,96,144,168,180,0,0,0,12,0,0,0,84,0,0,0,36,0,48,168,180,0,0,0,12,0,0,48,84,192,192,288,324,336,336,360,756,0,0,0,12,0,0,0,36,0,0,0,36,0,0,72,180,0,0,0,12,0,0,0,84,0,0,0,132,288,336,360,372,0,0,0,12,
0,0,0,84,0,0,0,36,0,144,168,564,0,384,384,396,576,576,624,660,576,672,672,708,720,732,1512,1524,0,0,0,0,0,0,0,36,0,0,0,36,0,0,72,180,0,0,0,12,0,0,0,84,0,0,0,132,96,144,360,372,0,0,0,12,0,0,0,84,0,0,0,36,0,144,168,180,0,0,0,12,0,0,240,660,576,672,672,708,720,732,744,756,0,0,0,12,0,0,0,36,
0,0,0,36,0,0,168,180,0,0,0,12,0,0,0,84,0,0,288,324,288,336,1128,1140,0,768,768,780,768,768,768,1236,1152,1152,1152,1188,1248,1296,1320,1332,1152,1152,1344,1380,1344,1344,1416,1428,1440,1440,1440,3012,3024,3036,3048,3060,0,0,0,0,0,0,0,36,0,0,0,36,0,0,72,84,0,0,0,12,0,0,0,84,0,0,0,36,96,144,168,372,0,0,0,12,0,0,0,84,0,0,0,36,
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47616,47616,47616,47628,47616,47616,47616,47700,47616,47616,47616,47652,47616,47760,47784,48180,48000,48000,48000,48012,48192,48192,48240,48276,48192,48288,48288,49092,49104,49116,49128,49140,48384,48384,48384,48396,48384,48384,48384,48468,48384,48384,48384,48420,48384,48432,48552,48564,48384,48384,48384,48396,48384,48384,48432,48660,48576,48576,48672,48708,48720,49116,49128,49140,48768,48768,48768,48780,48768,48768,48768,48852,48768,48768,48768,48804,48864,48912,48936,49140,48960,48960,48960,48996,48960,48960,49032,49140,49056,49056,49056,49092,49104,49116,49128,49140,};

unsigned int PulseTriSaw_8580[4096] = {
0,0,0,0,0,0,0,0,0,0,0,0,0,0,0,72,0,0,0,0,0,0,0,24,0,0,0,0,0,0,144,180,0,0,0,0,0,0,0,0,0,0,0,0,0,0,0,84,0,0,0,0,0,0,0,24,0,0,0,0,288,288,336,372,0,0,0,0,0,0,0,0,0,0,0,0,0,0,0,72,0,0,0,0,0,0,0,24,0,0,0,0,0,0,144,180,0,0,0,0,
0,0,0,24,0,0,0,0,0,0,0,84,0,0,0,0,0,0,0,24,192,576,576,576,672,672,720,756,0,0,0,0,0,0,0,0,0,0,0,0,0,0,0,72,0,0,0,0,0,0,0,24,0,0,0,0,0,0,144,180,0,0,0,0,0,0,0,0,0,0,0,0,0,0,0,84,0,0,0,0,0,0,0,24,0,0,0,0,288,288,336,372,0,0,0,0,0,0,0,0,
0,0,0,0,0,0,0,72,0,0,0,0,0,0,0,24,0,0,0,0,0,96,144,180,0,0,0,0,0,0,0,24,0,0,0,0,0,0,0,84,0,1152,1152,1152,1152,1152,1152,1176,1344,1344,1344,1344,1440,1440,1488,1524,0,0,0,0,0,0,0,0,0,0,0,0,0,0,0,72,0,0,0,0,0,0,0,24,0,0,0,0,0,0,144,180,0,0,0,0,0,0,0,0,0,0,0,0,
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46080,46080,46080,46080,46080,46080,46080,46080,46080,46080,46080,46080,46080,46080,46080,46164,46080,46080,46080,46080,46080,46080,46080,46104,46080,46080,46272,46272,46368,46368,46416,46452,47616,47616,47616,47616,47616,47616,47616,47616,47616,47616,47616,47616,47616,47616,47616,47688,47616,47616,47616,47616,47616,47616,47616,47640,47616,47616,47616,47616,47616,47712,47760,47796,48384,48384,48384,48384,48384,48384,48384,48408,48384,48384,48384,48384,48384,48384,48384,48468,48768,48768,48768,48768,48768,48768,48768,48792,48960,48960,48960,48960,49056,49056,49104,49140,};

